## board/freescale/magpie_lite/Kconfig
```kconfig
if TARGET_MAGPIE_LITE

config SYS_BOARD
	default "magpie_lite"

config SYS_VENDOR
	default "freescale"

config SYS_CONFIG_NAME
	default "magpie_lite"

config IMX_CONFIG
	default "board/freescale/magpie_lite/imximage-8mm.cfg"

config IMX8M_1G_MEMORY
	bool "imx8m 1GB memory size"

source "board/freescale/common/Kconfig"

endif
```
